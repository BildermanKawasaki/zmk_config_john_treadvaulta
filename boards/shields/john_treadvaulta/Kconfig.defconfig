## boards/shields/john_treadvaulta/Kconfig.defconfig
```kconfig
if SHIELD_JOHN_TREADVAULTA

# Name must be less than 16 characters long!
config ZMK_KEYBOARD_NAME
    default "John Treadvaulta"

endif
```

## boards/shields/john_treadvaulta/Kconfig.shield
```kconfig
config SHIELD_JOHN_TREADVAULTA
    def_bool $(shields_list_contains,john_treadvaulta)
```
